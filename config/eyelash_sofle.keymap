#define ZMK_POINTING_DEFAULT_MOVE_VAL 1200
#define ZMK_POINTING_DEFAULT_SCRL_VAL 25

#include <input/processors.dtsi>
#include <zephyr/dt-bindings/input/input-event-codes.h>
#include <behaviors.dtsi>
#include <dt-bindings/zmk/bt.h>
#include <dt-bindings/zmk/keys.h>
#include <dt-bindings/zmk/outputs.h>
#include <dt-bindings/zmk/pointing.h>
#include <dt-bindings/zmk/rgb.h>

&mmv_input_listener { input-processors = <&zip_xy_scaler 2 1>; };
&msc_input_listener { input-processors = <&zip_scroll_scaler 2 1>; };

&msc {
    acceleration-exponent = <1>;
    time-to-max-speed-ms = <100>;
    delay-ms = <0>;
};

&mmv {
    time-to-max-speed-ms = <500>;
    acceleration-exponent = <1>;
    trigger-period-ms = <16>;
};

&soft_off { hold-time-ms = <2000>; };

/ {
    //-----------------------------------------
    //     MACROS DE ACENTUAÇÃO
    //-----------------------------------------
    macros {
        compatible = "zmk,macros";

        a_acute: a_acute { compatible = "zmk,behavior-macro"; #binding-cells = <0>; bindings = <&kp QUOT>, <&kp A>; };
        a_grave: a_grave { compatible = "zmk,behavior-macro"; #binding-cells = <0>; bindings = <&kp GRAVE>, <&kp A>; };
        a_circ:  a_circ  { compatible = "zmk,behavior-macro"; #binding-cells = <0>; bindings = <&kp CARET>, <&kp A>; };
        a_tilde: a_tilde { compatible = "zmk,behavior-macro"; #binding-cells = <0>; bindings = <&kp TILDE>, <&kp A>; };

        e_acute: e_acute { compatible = "zmk,behavior-macro"; #binding-cells = <0>; bindings = <&kp QUOT>, <&kp E>; };
        e_circ:  e_circ  { compatible = "zmk,behavior-macro"; #binding-cells = <0>; bindings = <&kp CARET>, <&kp E>; };

        i_acute: i_acute { compatible = "zmk,behavior-macro"; #binding-cells = <0>; bindings = <&kp QUOT>, <&kp I>; };

        o_acute: o_acute { compatible = "zmk,behavior-macro"; #binding-cells = <0>; bindings = <&kp QUOT>, <&kp O>; };
        o_circ:  o_circ  { compatible = "zmk,behavior-macro"; #binding-cells = <0>; bindings = <&kp CARET>, <&kp O>; };
        o_tilde: o_tilde { compatible = "zmk,behavior-macro"; #binding-cells = <0>; bindings = <&kp TILDE>, <&kp O>; };

        u_acute: u_acute { compatible = "zmk,behavior-macro"; #binding-cells = <0>; bindings = <&kp QUOT>, <&kp U>; };

        c_ced:   c_ced   { compatible = "zmk,behavior-macro"; #binding-cells = <0>; bindings = <&kp COMMA>, <&kp C>; };
    };

    //-----------------------------------------
    // SENSOR SCROLL
    //-----------------------------------------
    scroll_encoder: scroll_encoder {
        compatible = "zmk,behavior-sensor-rotate";
        #sensor-binding-cells = <0>;
        bindings = <&msc SCRL_DOWN>, <&msc SCRL_UP>;
        tap-ms = <100>;
    };

    combos {
        compatible = "zmk,combos";
        softoff { bindings = <&soft_off>; key-positions = <14 28 40>; };
    };

    //-----------------------------------------
    // KEYMAP
    //-----------------------------------------
    keymap {
        compatible = "zmk,keymap";

        //------------------
        // LAYER 0
        //------------------
        layer0 {
            bindings = <
&kp ESC     &kp N1     &kp N2        &kp N3        &kp N4  &kp N5       &kp UP_ARROW     &kp N6     &kp N7     &kp N8     &kp N9           &kp N0      &kp BACKSPACE
&kp TAB     &kp Q      &kp W         &kp E         &kp R   &kp T        &kp DOWN_ARROW   &kp Y      &kp U      &kp I      &kp O            &kp P       &kp BSLH
&kp CAPS    &kp A      &kp S         &kp D         &kp F   &kp G        &kp LEFT_ARROW   &kp H      &kp J      &kp K      &kp L            &kp SEMI    &kp APOS
&kp LSHFT   &kp Z      &kp X         &kp C         &kp V   &kp B        &kp RIGHT_ARROW  &kp N      &kp M      &lt acentos COMMA  &kp DOT          &kp FSLH    &kp ENTER
&kp C_MUTE  &kp LCTRL  &kp LEFT_GUI  &kp LEFT_ALT  &mo 1   &kp SPACE    &kp ENTER        &kp SPACE  &kp ENTER  &mo 2      &kp RIGHT_SHIFT  &kp DELETE
            >;

            sensor-bindings = <&inc_dec_kp C_VOLUME_UP C_VOL_DN>;
            display-name = "LAYER0";
        };

        //------------------
        // LAYER 1
        //------------------
        layer_1 {
            bindings = <
&kp GRAVE   &kp F1           &kp F2          &kp F3           &kp F4           &kp F5             &mmv MOVE_UP     &kp F6           &kp F7           &kp F8      &kp F9     &kp F10           &trans
&trans      &kp GRAVE        &mkp LCLK       &mkp MCLK        &mkp RCLK        &mkp MB4           &mmv MOVE_DOWN   &kp PG_UP        &kp END          &kp UP      &kp HOME   &kp MINUS         &kp EQUAL
&trans      &kp TILDE        &trans          &trans           &trans           &mkp MB5           &mmv MOVE_LEFT   &kp PG_DN
